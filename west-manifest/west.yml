## west-manifest/west.yml
```yaml
manifest:
  remotes:
    - name: zephyrproject
      url-base: https://github.com/zephyrproject-rtos
  projects:
    - name: zephyr
      repo-path: zephyr
      remote: zephyrproject
      revision: 4bd1d39c67dfb4860fbd4f9ccc17e084aa32d763
      clone-depth: 1
      import:
        path-prefix: external
```
